## yocto/conf/bblayers.conf.sample
```bitbake
# LAYER_CONF_VERSION is increased each time build/conf/bblayers.conf
# changes incompatibly
LCONF_VERSION = "7"

BBPATH = "${TOPDIR}"

BBLAYERS ?= " \
  ${TOPDIR}/../sources/poky/meta \
  ${TOPDIR}/../sources/poky/meta-poky \
  ${TOPDIR}/../sources/poky/meta-yocto-bsp \
  ${TOPDIR}/../sources/meta-openembedded/meta-oe \
  ${TOPDIR}/../sources/meta-openembedded/meta-networking \
  ${TOPDIR}/../sources/meta-openembedded/meta-python \
  ${TOPDIR}/../sources/meta-raspberrypi \
  ${TOPDIR}/../sources/meta-rauc \
  ${TOPDIR}/../sources/meta-qt6 \
  ${TOPDIR}/../meta-myproduct \
  "
```

## yocto/conf/local.conf.sample
```bitbake
MACHINE = "raspberrypi4-64"
DISTRO = "myproduct"

DL_DIR ?= "/work/.cache/downloads"
SSTATE_DIR ?= "/work/.cache/sstate"


VIRTUAL-RUNTIME_init_manager = "systemd"
DISTRO_FEATURES:append = " systemd wayland opengl pam usrmerge"
DISTRO_FEATURES:append = " rauc"
DISTRO_FEATURES:remove = " x11 sysvinit"

IMAGE_FEATURES += "ssh-server-openssh"

# Accept firmware license for rpi wireless (demo)
LICENSE_FLAGS_ACCEPTED += "synaptics-killswitch"

# Disable custom RAUC config during boot-only bringup
BBMASK += "meta-myproduct/recipes-support/rauc/rauc-conf.bb"
# Keep weston-service enabled so weston/headunit auto-start on boot.

# RPi4 boot (demo, no U-Boot)
RPI_USE_U_BOOT = "0"
ENABLE_UART = "1"
RPI_EXTRA_CONFIG:append = " \n\
dtoverlay=vc4-kms-v3d\n\
gpu_mem=128\n\
disable_overscan=1\n\
hdmi_force_hotplug=1\n\
"

# RAUC
RAUC_KEY_FILE = "/work/keys/rauc.key.pem"
RAUC_CERT_FILE = "/work/keys/rauc.cert.pem"
RAUC_BUNDLE_COMPATIBLE = "ivi-hu-rpi4"

IMAGE_FSTYPES += "wic.gz"
WKS_FILE = "my-hu-image.wks"

# External sources for modular development
EXTERNALSRC:pn-ota-backend = "/work/services/ota-backend"
EXTERNALSRC:pn-headunit-ui = "/work/ui/qt-headunit"
```

## yocto/meta-myproduct/conf/distro/myproduct.conf
```bitbake
DISTRO_NAME = "myproduct"
DISTRO_VERSION = "1.0"

DISTRO_FEATURES:append = " systemd wayland opengl pam rauc usrmerge"
DISTRO_FEATURES:remove = " x11 sysvinit"

VIRTUAL-RUNTIME_init_manager = "systemd"

# Ensure KMS is enabled on RPi4 (override to avoid duplicates)
RPI_EXTRA_CONFIG = " \n\
dtoverlay=vc4-kms-v3d\n\
gpu_mem=128\n\
disable_overscan=1\n\
hdmi_force_hotplug=1\n\
"
```

## yocto/meta-myproduct/conf/layer.conf
```bitbake
BBPATH .= ":${LAYERDIR}"
BBFILES += "${LAYERDIR}/recipes-*/*/*.bb ${LAYERDIR}/recipes-*/*/*.bbappend"

BBFILE_COLLECTIONS += "myproduct"
BBFILE_PATTERN_myproduct = "^${LAYERDIR}/"
BBFILE_PRIORITY_myproduct = "6"

LAYERSERIES_COMPAT_myproduct = "scarthgap"
```

## yocto/meta-myproduct/recipes-core/images/my-hu-image.wks
```
part /boot --source bootimg-partition --fstype=vfat --label boot --size 256M
part / --source rootfs --fstype=ext4 --label rootfsA --size 2048M --align 4096
part / --source rootfs --fstype=ext4 --label rootfsB --size 2048M --align 4096
part /data --source rootfs --fstype=ext4 --label data --size 1024M
```
